## Kconfig
```kconfig
#
# Copyright 2015, Wink Saville
#
# This software may be distributed and modified according to the terms of
# the BSD 2-Clause license. Note that NO WARRANTY is provided.
# See "LICENSE_BSD2.txt" for details.
#

menuconfig LIB_SEL4_ASSERT
    bool "Build a simple __assert_fail library, needs seL4_Printf and seL4_Stop"
    default n
    help
        "Implements __assert_fail"
```
